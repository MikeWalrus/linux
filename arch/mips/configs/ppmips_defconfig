## arch/mips/configs/ppmips_defconfig
```kconfig
CONFIG_BLK_DEV_INITRD=y
CONFIG_INITRAMFS_SOURCE="/home/mike/repos/buildroot/output/images/rootfs.cpio"
# CONFIG_VIRTUALIZATION is not set
CONFIG_COMPAT_32BIT_TIME=y
CONFIG_NET=y
CONFIG_PACKET=y
CONFIG_UNIX=y
CONFIG_INET=y
CONFIG_OF=y
CONFIG_NETDEVICES=y
CONFIG_XILINX_EMACLITE=y
CONFIG_SERIAL_8250=y
CONFIG_SERIAL_8250_16550A_VARIANTS=y
CONFIG_SERIAL_8250_CONSOLE=y
CONFIG_SERIAL_OF_PLATFORM=y
CONFIG_XILINX_INTC=y
CONFIG_NFS_FS=y
CONFIG_DEBUG_KERNEL=y
CONFIG_DEBUG_INFO_DWARF_TOOLCHAIN_DEFAULT=y
CONFIG_FRAME_WARN=1024
# CONFIG_RCU_TRACE is not set
# CONFIG_FTRACE is not set
```

## arch/mips/ppmips/Kconfig
```kconfig
if MACH_PPMIPS

choice
	prompt "Machine type"
	default PPMIPS_NSCSCC

config PPMIPS_NSCSCC
	bool "PPMIPS SoC for NSCSCC 2022 board"

endchoice

config FIT_IMAGE_PPMIPS
	bool "FIT image for PPMIPS"

endif
```
